## esp32/components/muse/Kconfig
```kconfig
# Copyright (c) Meta Platforms, Inc. and affiliates.
#
# Licensed under the Apache License, Version 2.0 (the "License");
# you may not use this file except in compliance with the License.
# You may obtain a copy of the License at
#
#     http://www.apache.org/licenses/LICENSE-2.0
#
# Unless required by applicable law or agreed to in writing, software
# distributed under the License is distributed on an "AS IS" BASIS,
# WITHOUT WARRANTIES OR CONDITIONS OF ANY KIND, either express or implied.
# See the License for the specific language governing permissions and
# limitations under the License.

menu "Muse"

    choice MUSE_BOARD
        prompt "Board with the full UI"
        default MUSE_BOARD_NONE
        help
            The UI is the voice companion on boards with a screen: an
            animated avatar, push-to-talk chat, settings, and battery
            handling. It runs beside Home Link, which owns Wi-Fi, BLE
            pairing, credentials and OTA. Pick the board it runs on, or none
            for a Link without a display.

        config MUSE_BOARD_NONE
            bool "None (Home Link without a display)"

        config MUSE_BOARD_WAVESHARE_S3_175C
            bool "Waveshare ESP32-S3-Touch-AMOLED-1.75C"
            depends on IDF_TARGET_ESP32S3

        config MUSE_BOARD_WAVESHARE_S3_175
            bool "Waveshare ESP32-S3-Touch-AMOLED-1.75 (not the 1.75C)"
            depends on IDF_TARGET_ESP32S3

        config MUSE_BOARD_AIPI
            bool "AIPI Lite (ESP32-S3, two buttons, no touch)"
            depends on IDF_TARGET_ESP32S3

        config MUSE_BOARD_ESPRESSIF_BOX_3
            bool "Espressif ESP32-S3-BOX-3 (320x240 touch LCD, speaker and microphones)"
            depends on IDF_TARGET_ESP32S3

        config MUSE_BOARD_WAVESHARE_C6_18
            bool "Waveshare ESP32-C6-Touch-AMOLED-1.8"
            depends on IDF_TARGET_ESP32C6

        config MUSE_BOARD_WAVESHARE_C6_206
            bool "Waveshare ESP32-C6-Touch-AMOLED-2.06"
            depends on IDF_TARGET_ESP32C6

        config MUSE_BOARD_SENSECAP_WATCHER
            bool "Seeed SenseCAP Watcher (ESP32-S3, round touch LCD, wheel)"
            depends on IDF_TARGET_ESP32S3

        config MUSE_BOARD_M5STACK_CARDPUTER_ADV
            bool "M5Stack Cardputer ADV (ESP32-S3, keyboard, no PSRAM)"
            depends on IDF_TARGET_ESP32S3

        config MUSE_BOARD_M5STACK_STICKS3
            bool "M5Stack StickS3 (ESP32-S3, two buttons, no touch)"
            depends on IDF_TARGET_ESP32S3

        config MUSE_BOARD_M5STACK_STICKC_PLUS2
            bool "M5Stack StickC Plus2 (ESP32, two buttons, no touch)"
            depends on IDF_TARGET_ESP32

        config MUSE_BOARD_ESP32_S31_KORVO_1
            bool "Espressif ESP32-S31-Korvo-1 (S31, ES8389, 800x480 RGB LCD)"
            depends on IDF_TARGET_ESP32S31

        config MUSE_BOARD_M5STACK_STOPWATCH
            bool "M5Stack StopWatch (ESP32-S3, round touch AMOLED)"
            depends on IDF_TARGET_ESP32S3

        config MUSE_BOARD_M5STACK_CORES3
            bool "M5Stack CoreS3 (ESP32-S3, 320x240 touch LCD, speaker and microphones)"
            depends on IDF_TARGET_ESP32S3

        config MUSE_BOARD_M5STACK_CORE2
            bool "M5Stack Core2 v1.0 (ESP32, touch LCD, touch-strip talk)"
            depends on IDF_TARGET_ESP32
        config MUSE_BOARD_FNK0104B
            bool "Freenove FNK0104B (ESP32-S3, 240x320 touch LCD, ES8311 speaker and mic)"
            depends on IDF_TARGET_ESP32S3
        config MUSE_BOARD_GUITION_JC3248W535
            bool "Guition JC3248W535 (ESP32-S3, 3.5\" 320x480 touch LCD, speaker)"
            depends on IDF_TARGET_ESP32S3

        config MUSE_BOARD_WAVESHARE_S3_LCD7
            bool "Waveshare ESP32-S3-Touch-LCD-7 (800x480 touch LCD, no audio)"
            depends on IDF_TARGET_ESP32S3
    endchoice

    config MUSE_ENABLED
        bool
        default y if !MUSE_BOARD_NONE

    # Always defined, unlike the target-dependent board options, so
    # idf_component.yml rules can select each board's managed components.
    config MUSE_BOARD_ID
        string
        default "waveshare_s3_175c" if MUSE_BOARD_WAVESHARE_S3_175C
        default "waveshare_s3_175" if MUSE_BOARD_WAVESHARE_S3_175
        default "aipi" if MUSE_BOARD_AIPI
        default "espressif_box_3" if MUSE_BOARD_ESPRESSIF_BOX_3
        default "waveshare_c6_18" if MUSE_BOARD_WAVESHARE_C6_18
        default "waveshare_c6_206" if MUSE_BOARD_WAVESHARE_C6_206
        default "sensecap_watcher" if MUSE_BOARD_SENSECAP_WATCHER
        default "m5stack_sticks3" if MUSE_BOARD_M5STACK_STICKS3
        default "m5stack_stickc_plus2" if MUSE_BOARD_M5STACK_STICKC_PLUS2
        default "esp32_s31_korvo_1" if MUSE_BOARD_ESP32_S31_KORVO_1
        default "m5stack_cardputer_adv" if MUSE_BOARD_M5STACK_CARDPUTER_ADV
        default "m5stack_stopwatch" if MUSE_BOARD_M5STACK_STOPWATCH
        default "m5stack_cores3" if MUSE_BOARD_M5STACK_CORES3
        default "m5stack_core2" if MUSE_BOARD_M5STACK_CORE2
        default "fnk0104b" if MUSE_BOARD_FNK0104B
        default "guition_jc3248w535" if MUSE_BOARD_GUITION_JC3248W535
        default "waveshare_s3_lcd7" if MUSE_BOARD_WAVESHARE_S3_LCD7
        default "none"

    # The Muse tools' serial port: the console UART behind the board's USB
    # bridge, where the chip's own USB Serial/JTAG isn't wired to a connector
    # (the Watcher's USB-C goes to a CH342) or the chip has none.
    config MUSE_CONSOLE_UART
        bool
        default y if MUSE_BOARD_SENSECAP_WATCHER || MUSE_BOARD_WAVESHARE_S3_LCD7 || !SOC_USB_SERIAL_JTAG_SUPPORTED

    # A board overlay can raise this for a quiet speaker.
    config MUSE_DEFAULT_VOLUME
        int "Speaker volume until one is chosen in settings (percent)"
        range 0 100
        default 70

    config MUSE_WATCHER_CAMERA
        bool "SenseCAP Watcher camera capture and live preview"
        depends on MUSE_BOARD_SENSECAP_WATCHER && SPIRAM
        default n
        help
            Enable the camera.capture Home Link command and the wheel
            double-click camera preview. Camera buffers and tasks consume
            memory and preview decoding shares CPU time with voice and Link.
            Leave disabled to build without camera support.

    config MUSE_CJK_FONT
        bool "Show Chinese and Japanese in captions"
        depends on MUSE_ENABLED
        default n
        help
            Captions fall back to GNU Unifont's 16x16 bitmaps for CJK
            punctuation, kana, the CJK Unified Ideographs and fullwidth
            forms that the ASCII caption font lacks. Small screens, whose
            captions are two lines of 8 px text, show a reply with CJK in it
            one 16 px line at a time. Takes about 850 KB of flash and no RAM.
            Without it those characters show as boxes. Hangul isn't
            included.

    config MUSE_JC3248W535_MIC_GPIO
        int "JC3248W535: GPIO for an external I2S mic's data (SD) line"
        depends on MUSE_BOARD_GUITION_JC3248W535
        range -1 48
        default -1
        help
            The board has a speaker amp but no microphone. Wire an I2S MEMS
            mic such as an INMP441 to the speaker's clocks (SCK to GPIO42, WS
            to GPIO2), L/R to GND, power to 3.3 V, and its SD line to a free
            GPIO, and set that GPIO here. -1 leaves push-to-talk recording
            silence.

    config MUSE_HATCH
        bool "Muse's own voice session"
        depends on MUSE_ENABLED
        default y if SPIRAM
        default n
        help
            Push-to-talk turns go over a voice session of Muse's own, to the
            VM Home Link is paired with or one set up on the device with a
            device token. Replies are text, shown as captions; start_tts in
            muse_chat_session.cpp is where a TTS API of your own can speak
            them. Needs PSRAM. Without it, voice notes go over Home Link's own
            session to its paired VM and replies are shown as text.

endmenu
```

## esp32/components/muse_wakeword/Kconfig
```kconfig
# Copyright (c) Meta Platforms, Inc. and affiliates.
#
# Licensed under the Apache License, Version 2.0 (the "License");
# you may not use this file except in compliance with the License.
# You may obtain a copy of the License at
#
#     http://www.apache.org/licenses/LICENSE-2.0
#
# Unless required by applicable law or agreed to in writing, software
# distributed under the License is distributed on an "AS IS" BASIS,
# WITHOUT WARRANTIES OR CONDITIONS OF ANY KIND, either express or implied.
# See the License for the specific language governing permissions and
# limitations under the License.

# Always defined, unlike MUSE_WAKEWORD_ENABLE (a bool whose dependencies are
# unmet isn't written to sdkconfig), so this component's idf_component.yml can
# pull the ExecuTorch registry component only into builds with the feature.
config MUSE_WAKEWORD_EXECUTORCH
    string
    default "y" if MUSE_WAKEWORD_ENABLE
    default "n"

menu "Muse wake word"
    depends on MUSE_ENABLED

    config MUSE_WAKEWORD_ENABLE
        bool "Compile in hands-free wake word support"
        depends on SPIRAM && !MUSE_UI_FREEINK
        default n
        help
            Saying "Hey Muse" (or "Ok Muse") starts the same voice note
            as holding the talk button. This only compiles the feature
            in: listening also needs the opt-in on the device itself
            (Settings > Sound, the quick menu, or "wake.on" over
            serial), so flashing this firmware never starts listening
            on its own. No board overlay enables it.

            While listening is on, the microphone and codecs stay
            powered, so a battery board doesn't rest them when its
            screen sleeps: expect much shorter battery life with the
            wake word on.

            Detection runs on the device: the ExecuTorch model in
            models/hey_muse.pte, an int8 export of a streaming
            keyword-spotting network trained on synthetic speech from
            eight Piper voices (see models/README.md). Audio leaves the
            device only after a detection, as a voice note that starts
            at most 1 s before the speech following it (so it includes
            the wake word) and ends with that speech, the talk button,
            or 15 s. A detection with no speech after it sends nothing;
            one followed by speech sends a voice note, so a false
            trigger near conversation uploads one. This checkpoint's own
            streaming test (fp32, on its training bundle's test set)
            reports about 34 false wakes an hour at Default sensitivity
            (78.7% of wake words caught) and about 4 an hour at Low
            (51.3%); High wasn't measured. The int8 model on the device
            has not been measured on a device yet.

            Needs PSRAM: the audio buffers take about 133 KB and the
            ExecuTorch runner about 213 KB more (a 64 KB method arena,
            a 64 KB scratch arena, the model's 29.5 KB planned buffer
            and the 52 KB frontend), far beyond the internal RAM left
            with Wi-Fi up. Not available with the e-paper (FreeInk) UI,
            which has no wake word controls.

    choice MUSE_WAKEWORD_SENSITIVITY
        prompt "Wake word sensitivity"
        default MUSE_WAKEWORD_SENSITIVITY_DEFAULT
        depends on MUSE_WAKEWORD_ENABLE
        help
            The detector's threshold on the smoothed wake posterior
            (ww_detector.c): Low 0.99, Default 0.95, High 0.90. False wakes
            per hour on the checkpoint's own fp32 streaming test: about 4
            at Low and 34 at Default; High wasn't measured.

        config MUSE_WAKEWORD_SENSITIVITY_LOW
            bool "Low (about 4 false wakes an hour)"

        config MUSE_WAKEWORD_SENSITIVITY_DEFAULT
            bool "Default (about 34 false wakes an hour)"

        config MUSE_WAKEWORD_SENSITIVITY_HIGH
            bool "High (easiest to trigger; not measured)"
    endchoice

    choice MUSE_WAKEWORD_VAD
        prompt "Speech endpointing after a wake"
        default MUSE_WAKEWORD_VAD_ENERGY
        depends on MUSE_WAKEWORD_ENABLE
        help
            How the end of a hands-free turn is judged. Higher tiers are
            only offered when their model is integrated and the board's
            budgets allow them.

        config MUSE_WAKEWORD_VAD_ENERGY
            bool "Energy (audio level, no model)"
    endchoice

    config MUSE_WAKEWORD_START_TIMEOUT_MS
        int "No speech after a wake cancels the turn (ms)"
        default 2500
        range 100 10000
        depends on MUSE_WAKEWORD_ENABLE
        help
            The main false-trigger defence: if no speech follows the wake
            word within this time, the attempt is dropped and no audio
            leaves the device.

    config MUSE_WAKEWORD_END_SILENCE_MS
        int "Trailing silence that ends a hands-free turn (ms)"
        default 700
        range 100 5000
        depends on MUSE_WAKEWORD_ENABLE

    config MUSE_WAKEWORD_MAX_CAPTURE_MS
        int "Longest hands-free turn (ms)"
        default 15000
        range 1000 15000
        depends on MUSE_WAKEWORD_ENABLE
        help
            Hard cap even if endpointing never fires. The top of the range
            is the push-to-talk cap in muse_voice.c; a longer hands-free
            turn than a held button could record makes no sense.

endmenu
```
