## CMakeLists.txt
```
# Copyright (c) Meta Platforms, Inc. and affiliates.
#
# Licensed under the Apache License, Version 2.0 (the "License");
# you may not use this file except in compliance with the License.
# You may obtain a copy of the License at
#
#     http://www.apache.org/licenses/LICENSE-2.0
#
# Unless required by applicable law or agreed to in writing, software
# distributed under the License is distributed on an "AS IS" BASIS,
# WITHOUT WARRANTIES OR CONDITIONS OF ANY KIND, either express or implied.
# See the License for the specific language governing permissions and
# limitations under the License.

cmake_minimum_required(VERSION 3.20.0)

find_package(Zephyr REQUIRED HINTS $ENV{ZEPHYR_BASE})
project(mg_unit)

set(MG_SRC ${CMAKE_CURRENT_SOURCE_DIR}/../../src)
include(${CMAKE_CURRENT_SOURCE_DIR}/../../cmake/mg_common.cmake)

target_include_directories(app PRIVATE ${MG_PROTOCOLS} ${MG_SRC} src ${CMAKE_CURRENT_BINARY_DIR})
# After src: the app's own mg_token_proof.h comes first.
target_include_directories(app PRIVATE ${MG_SRC}/../../portable/mg_device_session/include
  ${MG_SRC}/../../portable/mg_link_setup/include)
target_compile_definitions(app PRIVATE MGLS_CRYPTO_PSA)

# The portable modules under test; the rest (BLE, audio thread, LED) are
# replaced by src/fakes.c.
target_sources(app PRIVATE
  ${MG_SRC}/mg_core.c
  ${MG_SRC}/mg_clock.c
  ${MG_SRC}/mg_power.c
  ${MG_SRC}/mg_boot.c
  ${MG_SRC}/mg_settings.c
  ${MG_SRC}/mg_session.c
  ${MG_SRC}/mg_identity.c
  ${MG_SRC}/mg_json.c
  ${MG_SRC}/mg_psa.c
  ${MG_SRC}/mg_setup.c
  ${MG_SRC}/mg_setup_crypto.c
  ${MG_SRC}/mg_setup_store.c
  ${MG_SRC}/mg_token_proof.c
  ${MG_SRC}/mg_codec.c
  ${MG_SRC}/mg_queue.c
  ${MG_SRC}/mg_hpf.c
  ${MG_SRC}/mg_connparam.c
  ${MG_SRC}/mg_throughput.c
  ${MG_SRC}/mg_envelope.c
  ${MG_SRC}/mg_vm_session.c
  ${MG_SRC}/mg_vm_link.c
  ${MG_SRC}/../../portable/mg_device_session/src/mg_session_seal.c
  ${MG_SRC}/mg_seal_crypto.c
  src/fakes.c
  src/test_settings.c
  src/test_core.c
  src/test_codec.c
  src/test_queue.c
  src/test_hpf.c
  src/test_throughput.c
  src/test_proof.c
  src/test_flash_writes.c
  ${MG_SRC}/mg_bt_txfix.c
  src/test_bt_txfix.c
)

mg_add_sbc(app)
mg_add_lc3(app)

mg_add_transcript(app)

# Link setup and token proof vectors, straight from the JSON files.
set(LINK_JSON ${MG_ROOT}/../esp32/tests/vectors/link_pairing_v5.json)
set(PROOF_JSON ${MG_PROTOCOLS}/test-vectors/mg-token-proof-v1.json)
set(GEN ${CMAKE_CURRENT_SOURCE_DIR}/../host/gen_vectors.py)
add_custom_command(
  OUTPUT ${CMAKE_CURRENT_BINARY_DIR}/vectors.h
  COMMAND ${PYTHON_EXECUTABLE} ${GEN} ${LINK_JSON} ${PROOF_JSON} ${CMAKE_CURRENT_BINARY_DIR}/vectors.h
  DEPENDS ${LINK_JSON} ${PROOF_JSON} ${GEN}
)
add_custom_target(mg_vectors DEPENDS ${CMAKE_CURRENT_BINARY_DIR}/vectors.h)
add_dependencies(app mg_vectors)

# Every flash write through settings is counted (test_flash_writes.c): none
# per connection or link drop.
zephyr_link_libraries(-Wl,--wrap=settings_save_one -Wl,--wrap=settings_delete)
```

## prj.conf
```kconfig
# Copyright (c) Meta Platforms, Inc. and affiliates.
#
# Licensed under the Apache License, Version 2.0 (the "License");
# you may not use this file except in compliance with the License.
# You may obtain a copy of the License at
#
#     http://www.apache.org/licenses/LICENSE-2.0
#
# Unless required by applicable law or agreed to in writing, software
# distributed under the License is distributed on an "AS IS" BASIS,
# WITHOUT WARRANTIES OR CONDITIONS OF ANY KIND, either express or implied.
# See the License for the specific language governing permissions and
# limitations under the License.

CONFIG_ZTEST=y
CONFIG_ZTEST_STACK_SIZE=16384
CONFIG_MAIN_STACK_SIZE=4096

CONFIG_FLASH=y
CONFIG_FLASH_MAP=y
CONFIG_ZMS=y
CONFIG_SETTINGS=y
CONFIG_SETTINGS_ZMS=y
CONFIG_CRC=y

CONFIG_MG_AUDIO_SRC_SYNTH=y
CONFIG_MG_NUS=n
CONFIG_MG_LC3=y
# A board with a vibration motor and a status light; the slot1 configuration
# turns haptics off, like the XIAO.
CONFIG_MG_HAPTICS=y
CONFIG_MG_ASSISTANT_STATE=y
CONFIG_MG_BATTERY_STATUS=y
CONFIG_MG_POWER_OFF=y

# PSA Crypto (Link setup, token proof) needs a random source on native_sim.
CONFIG_TEST_RANDOM_GENERATOR=y
CONFIG_MBEDTLS_PSA_CRYPTO_EXTERNAL_RNG_ALLOW_NON_CSPRNG=y
CONFIG_MBEDTLS_PSA_KEY_SLOT_COUNT=16
CONFIG_MG_SDK_TOKEN="mgst_unit_test"

CONFIG_LOG=y
CONFIG_LOG_MODE_IMMEDIATE=y
CONFIG_ASSERT=y
CONFIG_CBPRINTF_FP_SUPPORT=y
```

## src/fakes.c
```c
/*
 * Copyright (c) Meta Platforms, Inc. and affiliates.
 *
 * Licensed under the Apache License, Version 2.0 (the "License");
 * you may not use this file except in compliance with the License.
 * You may obtain a copy of the License at
 *
 *     http://www.apache.org/licenses/LICENSE-2.0
 *
 * Unless required by applicable law or agreed to in writing, software
 * distributed under the License is distributed on an "AS IS" BASIS,
 * WITHOUT WARRANTIES OR CONDITIONS OF ANY KIND, either express or implied.
 * See the License for the specific language governing permissions and
 * limitations under the License.
 */

#include "fakes.h"
#include "mg_core.h"
#include "mg_queue.h"

#include <errno.h>
#include <string.h>

#include <zephyr/kernel.h>

#include "mg_led.h"
#include "mg_session.h"
#include "mg_settings.h"

struct fake_note fake_notes[FAKE_MAX_NOTES];
int fake_nnotes;
uint16_t fake_mtu = 247;
int fake_disconnects;
int fake_buzzes;
uint32_t fake_led_flags;

int fake_audio_starts;
uint8_t fake_audio_codec;
uint16_t fake_audio_rate;
uint16_t fake_audio_kbps;
bool fake_audio_ptt;
int fake_audio_stops;
int fake_audio_recordings;
int fake_audio_clip_reads;
uint16_t fake_audio_clip;
uint8_t fake_audio_gain;
enum mg_audio_activity fake_audio_state;
int fake_led_events[4];

void fake_settle_wipe(void)
{
	/* An owner change's erase in the background (mg_queue_forget) from an
	 * earlier test ends, and its mark with it. */
	for (int i = 0; i < 10000 && mg_queue_wiping(); i++) {
		k_sleep(K_MSEC(1));
	}
	k_sleep(K_MSEC(1));
}

void fake_reset(void)
{
	fake_audio_start_fail = 0;
	fake_audio_last_silent = false;
	fake_settle_wipe();
	fake_nnotes = 0;
	fake_urgent_notes = 0;
	fake_peer_name[0] = '\0';
	fake_urgent_fail = 0;
	fake_mtu = 247;
	fake_disconnects = 0;
	fake_buzzes = 0;
	fake_audio_starts = 0;
	fake_audio_codec = 0;
	fake_audio_rate = 0;
	fake_audio_kbps = 0;
	fake_audio_ptt = false;
	fake_audio_stops = 0;
	fake_audio_recordings = 0;
	fake_audio_commits = 0;
	fake_audio_discards = 0;
	memset(fake_led_events, 0, sizeof(fake_led_events));
	fake_audio_clip_reads = 0;
	fake_audio_state = MG_AUDIO_IDLE;
	fake_audio_gated = 0;
	fake_audio_turns = 0;
	fake_audio_gate_fails = 0;
	fake_audio_gate_drops = 0;
}

const struct fake_note *fake_find(uint8_t ch, uint8_t cmd, int nth)
{
	for (int i = 0; i < fake_nnotes; i++) {
		if (fake_notes[i].ch == ch && fake_notes[i].len > 0 &&
		    fake_notes[i].data[0] == cmd && nth-- == 0) {
			return &fake_notes[i];
		}
	}
	return NULL;
}

int fake_count(uint8_t ch, uint8_t cmd)
{
	int n = 0;

	while (fake_find(ch, cmd, n)) {
		n++;
	}
	return n;
}

void fake_connect(void)
{
	mg_session_connected();
	mg_session_subscribed(MG_ATT_CONTROL, true);
	mg_session_subscribed(MG_ATT_DATA, true);
	mg_session_status_requested(); /* as a client's request_status */
	/* The suites' central is a bench client (mic output without a
	 * token proof); test_core's unproven-central cases turn it off. */
	(void)mg_core_set_bench(true, "unit test", true);
}

/* Transport */

int fake_notify_delay_us;
int fake_data_notes;

char fake_peer_name[40]; /* mg_transport_peer_name */

size_t mg_transport_peer_name(char *out, size_t cap)
{
	size_t n = MIN(strlen(fake_peer_name), cap - 1);

	memcpy(out, fake_peer_name, n);
	out[n] = '\0';
	return n;
}

bool mg_transport_tx_stalled(void)
{
	return false;
}

unsigned int mg_transport_notify_dropped(void)
{
	return 0;
}

bool mg_transport_tx_pending(void)
{
	return false;
}

bool mg_transport_evt_saturated(uint32_t stale_ms)
{
	ARG_UNUSED(stale_ms);
	return false;
}

bool mg_transport_tx_dead(void)
{
	return false;
}

void mg_transport_rx_request(void)
{
}

int fake_urgent_notes; /* mg_transport_notify_urgent */
int fake_urgent_fail;  /* the next N urgent notifications fail (-ENOMEM) */

int mg_transport_notify_urgent(enum mg_att_chan ch, const uint8_t *buf, size_t len)
{
	if (fake_urgent_fail > 0) {
		fake_urgent_fail--;
		return -ENOMEM;
	}
	fake_urgent_notes++;
	return mg_transport_notify(ch, buf, len, K_NO_WAIT);
}

k_timeout_t fake_last_control_wait;

int mg_transport_notify(enum mg_att_chan ch, const uint8_t *buf, size_t len, k_timeout_t wait)
{
	if (ch == MG_ATT_CONTROL) {
		fake_last_control_wait = wait;
	}
	if (len + 3 > fake_mtu) {
		return -EMSGSIZE; /* the stack refuses it (ATT MTU - 3) */
	}
	if (ch == MG_ATT_DATA) {
		fake_data_notes++;
		if (fake_notify_delay_us) {
			k_sleep(K_USEC(fake_notify_delay_us));
			return 0; /* not kept: a test stream would fill the list */
		}
	}
	if (fake_nnotes == FAKE_MAX_NOTES || len > sizeof(fake_notes[0].data)) {
		return -ENOMEM;
	}
	fake_notes[fake_nnotes].ch = ch;
	fake_notes[fake_nnotes].len = len;
	memcpy(fake_notes[fake_nnotes].data, buf, len);
	fake_nnotes++;
	return 0;
}

int fake_adv_boosts;

void mg_transport_adv_boost(void)
{
	fake_adv_boosts++;
}

bool mg_transport_link_up(void)
{
	return true;
}

bool mg_transport_att_ok(void)
{
	return true;
}

bool fake_audio_last_silent;

bool mg_audio_last_turn_silent(void)
{
	return fake_audio_last_silent;
}

int fake_button_flushes;
/* A board's update prompt (mg_board_press_take, the real core's route):
 * this many presses answer it. */
int fake_board_prompt_presses;

bool mg_board_press_take(bool real, bool injected_counts)
{
	if (fake_board_prompt_presses > 0 && (real || injected_counts)) {
		fake_board_prompt_presses--;
		return true;
	}
	return false;
}

void mg_button_flush_injected(void)
{
	fake_button_flushes++;
}

void mg_transport_disconnect(void)
{
	fake_disconnects++;
}

uint16_t mg_transport_att_mtu(void)
{
	return fake_mtu;
}

uint32_t mg_transport_conn_gen(void)
{
	return 0;
}

bool mg_transport_encrypted(void)
{
	return true;
}

const char *mg_transport_name(void)
{
	return "MuseGadget-A1B2C3";
}

int fake_power_offs;

void mg_app_power_off(const char *why)
{
	ARG_UNUSED(why);
	fake_power_offs++;
}

const char *mg_app_version(void)
{
	return "1.0.0";
}

void mg_ble_refresh_advertising(void)
{
}

struct k_work_q *mg_app_wq(void)
{
	return &k_sys_work_q;
}

/* LED */

void mg_led_set(uint32_t flag, bool on)
{
	if (on) {
		fake_led_flags |= flag;
	} else {
		fake_led_flags &= ~flag;
	}
}

bool mg_led_update_cue_showing(void)
{
	return mg_led_update_cue_shows(fake_led_flags);
}

void mg_led_event(enum mg_led_event e)
{
	if ((unsigned int)e < 4) {
		fake_led_events[e]++;
	}
}

struct fake_conn_req fake_conn_reqs[16];
int fake_nconn_reqs;

int fake_latency_cancels;

int mg_transport_latency_cancel(void)
{
	fake_latency_cancels++;
	return 0;
}

int mg_transport_conn_params(uint16_t interval_min, uint16_t interval_max, uint16_t latency,
			     uint16_t timeout)
{
	if (fake_nconn_reqs < (int)ARRAY_SIZE(fake_conn_reqs)) {
		fake_conn_reqs[fake_nconn_reqs] = (struct fake_conn_req){
			interval_min, interval_max, latency, timeout};
	}
	fake_nconn_reqs++;
	return 0;
}

int fake_led_link;
int fake_led_face;
int fake_led_faces;

void mg_led_set_link(enum mg_led_link link)
{
	fake_led_link = link;
}

void mg_led_set_face(enum mg_led_face face, const char *why)
{
	ARG_UNUSED(why);
	fake_led_face = face;
	fake_led_faces++;
}

enum mg_led_face mg_led_face(void)
{
	return fake_led_face;
}

const char *mg_led_link_name(enum mg_led_link link)
{
	static const char *const n[] = {"never", "disconnected", "connecting", "session", "ready"};

	return link < ARRAY_SIZE(n) ? n[link] : "?";
}

void mg_led_buzz(uint16_t freq_hz, uint16_t duration_ms, uint8_t volume)
{
	ARG_UNUSED(freq_hz);
	ARG_UNUSED(duration_ms);
	ARG_UNUSED(volume);
	fake_buzzes++;
}

/* Audio thread */

int fake_audio_start_fail; /* the next N mg_audio_start_live() calls fail (busy) */

int mg_audio_start_live(uint8_t codec, uint16_t rate, uint16_t kbps, bool ptt)
{
	if (fake_audio_start_fail > 0) {
		fake_audio_start_fail--;
		return -EBUSY;
	}
	fake_audio_starts++;
	fake_audio_codec = codec;
	fake_audio_rate = rate;
	fake_audio_kbps = kbps;
	fake_audio_ptt = ptt;
	fake_audio_state = MG_AUDIO_LIVE;
	return 0;
}

int mg_audio_start_recording(uint8_t codec, uint16_t kbps)
{
	fake_audio_recordings++;
	fake_audio_codec = codec;
	fake_audio_rate = MG_AUDIO_DEFAULT_SAMPLE_RATE_HZ;
	fake_audio_kbps = kbps;
	fake_audio_state = MG_AUDIO_RECORDING;
	return 0;
}

int mg_audio_read_clip(uint16_t index)
{
	fake_audio_clip_reads++;
	fake_audio_clip = index;
	fake_audio_state = MG_AUDIO_CLIP;
	return 0;
}

int fake_audio_commits;
int fake_audio_discards;

int mg_audio_start_held(enum mg_audio_activity what, uint8_t codec, uint16_t rate, uint16_t kbps)
{
	if (what == MG_AUDIO_RECORDING) {
		int err = mg_audio_start_recording(codec, kbps);

		fake_audio_rate = rate; /* what the core asked for */
		return err;
	}
	return mg_audio_start_live(codec, rate, kbps, true);
}

void mg_audio_commit(void)
{
	fake_audio_commits++;
}

void mg_audio_discard(void)
{
	fake_audio_discards++;
	fake_audio_state = MG_AUDIO_IDLE;
}

void mg_audio_stop(void)
{
	fake_audio_stops++;
	fake_audio_state = MG_AUDIO_IDLE;
}

enum mg_audio_activity mg_audio_activity(void)
{
	return fake_audio_state;
}

void mg_audio_current_format(struct mg_audio_format *fmt)
{
	(void)mg_codec_format(mg_settings_get()->audio_codec, fmt);
}

void mg_audio_set_gain(uint8_t gain)
{
	fake_audio_gain = gain;
}

/* The output gate: the fake holds nothing; it counts what the core asks
 * and passes gestures straight through (held ones are the audio thread's). */
int fake_audio_gated;
int fake_audio_turns;
int fake_audio_gate_fails;
int fake_audio_gate_drops;

int mg_audio_start_live_gated(uint8_t codec, uint16_t rate, uint16_t kbps)
{
	fake_audio_gated++;
	return mg_audio_start_live(codec, rate, kbps, false);
}

int mg_audio_start_turn_held(void)
{
	fake_audio_turns++;
	return mg_audio_start_live(mg_data_type_audio_sbc, MG_AUDIO_DEFAULT_SAMPLE_RATE_HZ, 0,
				   true);
}

void mg_audio_out_control(const uint8_t *buf, size_t len)
{
	(void)mg_session_send_control(buf, len);
}

void mg_audio_gate_fail(void)
{
	fake_audio_gate_fails++;
}

void mg_audio_gate_drop(void)
{
	fake_audio_gate_drops++;
}

bool mg_audio_output_held(void)
{
	return false;
}

void mg_audio_gate_stats(struct mg_audio_gate_stats *st)
{
	memset(st, 0, sizeof(*st));
}

/* One-time bring-up shared by the suites. */
#include <zephyr/settings/settings.h>

#include "mg_core.h"
#include "mg_identity.h"
#include "mg_queue.h"
#include "mg_setup.h"
#include "mg_setup_store.h"

void fake_init_once(void)
{
	static bool done;

	if (done) {
		return;
	}
	done = true;
	(void)settings_subsys_init();
	(void)mg_settings_load();
	(void)mg_setup_store_load();
	(void)mg_queue_init();
	mg_core_init();
	static const uint8_t addr[6] = {0x02, 0, 0, 0, 0, 0x01};

	mg_identity_init("MuseGadget-", "", addr);
	mg_setup_init();
	mg_session_init();
}
```

## src/fakes.h
```c
/*
 * Copyright (c) Meta Platforms, Inc. and affiliates.
 *
 * Licensed under the Apache License, Version 2.0 (the "License");
 * you may not use this file except in compliance with the License.
 * You may obtain a copy of the License at
 *
 *     http://www.apache.org/licenses/LICENSE-2.0
 *
 * Unless required by applicable law or agreed to in writing, software
 * distributed under the License is distributed on an "AS IS" BASIS,
 * WITHOUT WARRANTIES OR CONDITIONS OF ANY KIND, either express or implied.
 * See the License for the specific language governing permissions and
 * limitations under the License.
 */

#ifndef FAKES_H_
#define FAKES_H_

#include <stdbool.h>
#include <stdint.h>

#include "mg_audio.h"
#include "mg_transport.h"

struct fake_note {
	uint8_t ch;
	uint16_t len;
	uint8_t data[260];
};

#define FAKE_MAX_NOTES 64
extern struct fake_note fake_notes[FAKE_MAX_NOTES];
extern int fake_nnotes;
extern int fake_urgent_notes; /* mg_transport_notify_urgent */
extern char fake_peer_name[40]; /* the central's GAP Device Name */
extern int fake_urgent_fail;  /* the next N urgent notifications fail */
extern uint16_t fake_mtu;
extern int fake_disconnects;
extern int fake_adv_boosts; /* mg_transport_adv_boost */
extern int fake_buzzes;
extern int fake_power_offs;
extern int fake_audio_commits;
extern int fake_audio_gated;
extern int fake_audio_turns;
extern int fake_audio_gate_fails;
extern int fake_audio_gate_drops;
extern int fake_audio_discards;
extern int fake_led_events[4]; /* per enum mg_led_event */
extern uint32_t fake_led_flags;
extern int fake_led_link;
extern int fake_led_face;
extern int fake_led_faces; /* face changes */

/* Connection parameter requests (mg_transport_conn_params). */
struct fake_conn_req {
	uint16_t min, max, latency, timeout;
};
extern struct fake_conn_req fake_conn_reqs[16];
extern int fake_nconn_reqs;
extern int fake_latency_cancels; /* mg_transport_latency_cancel */

/* Audio calls mg_core made. */
extern int fake_audio_starts;
extern uint8_t fake_audio_codec;
extern uint16_t fake_audio_rate;
extern uint16_t fake_audio_kbps;
extern bool fake_audio_ptt;
extern int fake_audio_stops;
extern int fake_audio_recordings;
extern int fake_audio_clip_reads;
extern uint16_t fake_audio_clip;
extern uint8_t fake_audio_gain;
extern enum mg_audio_activity fake_audio_state;

/* Sleep this long in each Data notification (paces a sending thread). */
extern int fake_notify_delay_us;
/* Data notifications seen, and how many (counted even past FAKE_MAX_NOTES). */
extern int fake_data_notes;

void fake_reset(void);
void fake_settle_wipe(void);
/* nth (0-based) notification on ch whose first byte is cmd, or NULL. */
const struct fake_note *fake_find(uint8_t ch, uint8_t cmd, int nth);
int fake_count(uint8_t ch, uint8_t cmd);
/* Connects and subscribes the characteristics a session needs. */
void fake_connect(void);
/* mg_button_flush_injected() calls (mg_core.c's confirm-arming hook). */
extern int fake_button_flushes;
extern int fake_board_prompt_presses;
/* settings, queue, core and session, once. */
void fake_init_once(void);

extern k_timeout_t fake_last_control_wait; /* mg_transport_notify()'s last Control wait */
extern int fake_audio_start_fail; /* the next N mg_audio_start_live() calls fail */
extern bool fake_audio_last_silent; /* mg_audio_last_turn_silent() */

#endif
```

## src/test_bt_txfix.c
```c
/*
 * Copyright (c) Meta Platforms, Inc. and affiliates.
 *
 * Licensed under the Apache License, Version 2.0 (the "License");
 * you may not use this file except in compliance with the License.
 * You may obtain a copy of the License at
 *
 *     http://www.apache.org/licenses/LICENSE-2.0
 *
 * Unless required by applicable law or agreed to in writing, software
 * distributed under the License is distributed on an "AS IS" BASIS,
 * WITHOUT WARRANTIES OR CONDITIONS OF ANY KIND, either express or implied.
 * See the License for the specific language governing permissions and
 * limitations under the License.
 */

/* mg_bt_txfix.c with the kernel: a disconnect the host asks for on the thread
 * that sends its ACL data (the TX processor, conn.c's bt_send()) goes out
 * from the system work queue, never inline there (a peer gone mid-send,
 * then bt_hci_disconnect() waiting on its own thread);
 * any other thread's goes out inline as before. */

#include <zephyr/kernel.h>
#include <zephyr/net_buf.h>
#include <zephyr/ztest.h>

int __wrap_bt_send(struct net_buf *buf);
int __wrap_bt_hci_disconnect(uint16_t handle, uint8_t reason);

static int real_disc_calls;
static k_tid_t real_disc_thread;
static uint16_t real_disc_handle;
static K_SEM_DEFINE(real_disc_sem, 0, 4);

int __real_bt_send(struct net_buf *buf)
{
	ARG_UNUSED(buf);
	return 0;
}

int __real_bt_hci_disconnect(uint16_t handle, uint8_t reason)
{
	ARG_UNUSED(reason);
	real_disc_calls++;
	real_disc_thread = k_current_get();
	real_disc_handle = handle;
	k_sem_give(&real_disc_sem);
	return -EIO; /* "unknown connection": the link is already gone */
}

#define STACK 2048
static K_THREAD_STACK_DEFINE(tx_stack, STACK);
static K_THREAD_STACK_DEFINE(other_stack, STACK);
static struct k_thread tx_t, other_t;
static int tx_ret = 1, other_ret = 1;
static int calls_seen_inline = -1;

/* The TX processor: an ACL send fails, and the host disconnects right there. */
static void tx_fn(void *a, void *b, void *c)
{
	ARG_UNUSED(a); ARG_UNUSED(b); ARG_UNUSED(c);
	(void)__wrap_bt_send(NULL);
	tx_ret = __wrap_bt_hci_disconnect(0x0000, 0x13);
	calls_seen_inline = real_disc_calls; /* nothing sent on this thread */
}

static void other_fn(void *a, void *b, void *c)
{
	ARG_UNUSED(a); ARG_UNUSED(b); ARG_UNUSED(c);
	other_ret = __wrap_bt_hci_disconnect(0x0001, 0x13);
}

ZTEST(bt_txfix, test_tx_thread_disconnect_moves_to_sys_workq)
{
	int calls0 = real_disc_calls;

	k_sem_reset(&real_disc_sem);
	/* Cooperative, as the host's TX processor (its work queue's priority). */
	k_thread_create(&tx_t, tx_stack, STACK, tx_fn, NULL, NULL, NULL, K_PRIO_COOP(1), 0,
			K_NO_WAIT);
	k_thread_join(&tx_t, K_SECONDS(1));
	zassert_equal(tx_ret, 0, "the TX thread's disconnect returns at once");
	zassert_equal(calls_seen_inline, calls0, "not sent on the TX thread");
	zassert_ok(k_sem_take(&real_disc_sem, K_SECONDS(2)), "sent later");
	zassert_equal(real_disc_calls, calls0 + 1, "sent once");
	zassert_equal(real_disc_thread, &k_sys_work_q.thread, "from the system work queue");
	zassert_equal(real_disc_handle, 0x0000);

	/* Any other thread: inline, its result passed back, nothing moved. */
	k_thread_create(&other_t, other_stack, STACK, other_fn, NULL, NULL, NULL, K_PRIO_PREEMPT(5),
			0, K_NO_WAIT);
	k_thread_join(&other_t, K_SECONDS(1));
	zassert_equal(other_ret, -EIO, "inline, the controller's answer");
	zassert_equal(real_disc_calls, calls0 + 2);
	zassert_equal(real_disc_thread, &other_t);
	zassert_equal(real_disc_handle, 0x0001);
}

/* Two links' disconnects asked on the TX thread before the work
 * runs both go out. */
static void tx_two_fn(void *a, void *b, void *c)
{
	ARG_UNUSED(a); ARG_UNUSED(b); ARG_UNUSED(c);
	(void)__wrap_bt_send(NULL);
	tx_ret = __wrap_bt_hci_disconnect(0x0010, 0x13);
	other_ret = __wrap_bt_hci_disconnect(0x0011, 0x13);
}

ZTEST(bt_txfix, test_two_links_both_sent)
{
	int before = real_disc_calls;

	k_sem_reset(&real_disc_sem);
	k_thread_create(&tx_t, tx_stack, STACK, tx_two_fn, NULL, NULL, NULL, K_PRIO_COOP(1), 0,
			K_NO_WAIT);
	k_thread_join(&tx_t, K_SECONDS(1));
	zassert_equal(tx_ret, 0);
	zassert_equal(other_ret, 0);
	zassert_ok(k_sem_take(&real_disc_sem, K_SECONDS(2)));
	zassert_ok(k_sem_take(&real_disc_sem, K_SECONDS(2)));
	zassert_equal(real_disc_calls, before + 2, "both links' disconnects sent");
}

ZTEST_SUITE(bt_txfix, NULL, NULL, NULL, NULL, NULL);
```

## src/test_codec.c
```c
/*
 * Copyright (c) Meta Platforms, Inc. and affiliates.
 *
 * Licensed under the Apache License, Version 2.0 (the "License");
 * you may not use this file except in compliance with the License.
 * You may obtain a copy of the License at
 *
 *     http://www.apache.org/licenses/LICENSE-2.0
 *
 * Unless required by applicable law or agreed to in writing, software
 * distributed under the License is distributed on an "AS IS" BASIS,
 * WITHOUT WARRANTIES OR CONDITIONS OF ANY KIND, either express or implied.
 * See the License for the specific language governing permissions and
 * limitations under the License.
 */

#include <math.h>
#include <stdio.h>
#include <string.h>

#include <zephyr/ztest.h>

#include <lc3.h>
#include <sbc.h>

#include "mg_codec.h"

/*
 * Encodes one second of a two-tone signal with each codec, decodes it with
 * the vendored decoder and checks the frame format and the SNR at the best
 * alignment. The encoded streams are also printed (MGSTREAM lines) so
 * tests/tools/xcheck.py can decode them with the upstream reference
 * decoders.
 */

#define RATE    16000
#define SECONDS 1
#define N       (RATE * SECONDS)

static int16_t pcm_in[N];
static int16_t pcm_out[N + 400];
static uint8_t stream[16000];

static void make_signal(void)
{
	for (int i = 0; i < N; i++) {
		float t = (float)i / RATE;

		pcm_in[i] = (int16_t)(6000.0f * sinf(2 * 3.14159265f * 440.0f * t) +
				      3000.0f * sinf(2 * 3.14159265f * 1500.0f * t));
	}
}

/* SNR (dB) of out against in, at the lag in [0, max_lag] that fits best,
 * skipping the first 50 ms. */
static double best_snr(const int16_t *out, int n_out, int max_lag, int *lag_out)
{
	double best = -100;

	for (int lag = 0; lag <= max_lag; lag++) {
		double sig = 0, err = 0;

		for (int i = 800; i + lag < n_out && i < N; i++) {
			double d = (double)out[i + lag] - pcm_in[i];

			sig += (double)pcm_in[i] * pcm_in[i];
			err += d * d;
		}
		double snr = 10 * log10(sig / (err + 1e-9));

		if (snr > best) {
			best = snr;
			*lag_out = lag;
		}
	}
	return best;
}

static void dump(const char *name, const uint8_t *b, size_t n)
{
	char line[2 * 64 + 1];

	for (size_t off = 0; off < n; off += 64) {
		size_t m = MIN((size_t)64, n - off);

		for (size_t i = 0; i < m; i++) {
			snprintf(&line[2 * i], 3, "%02x", b[off + i]);
		}
		printk("MGSTREAM %s %s\n", name, line);
	}
}

ZTEST(codec, test_sbc_roundtrip)
{
	struct mg_audio_format f;
	size_t len = 0;
	int nframes = 0;

	make_signal();
	zassert_equal(mg_codec_format(mg_data_type_audio_sbc, &f), 0);
	zassert_equal(mg_codec_open(mg_data_type_audio_sbc), 0);
	for (int i = 0; i + f.frame_samples <= N; i += f.frame_samples) {
		int n = mg_codec_encode(&pcm_in[i], &stream[len], sizeof(stream) - len);

		zassert_equal(n, 60);
		/* Header: syncword, 16 kHz / 16 blocks / mono / loudness / 8 subbands,
		 * bitpool. */
		zassert_equal(stream[len], 0x9c);
		zassert_equal(stream[len + 1], 0x31, "got 0x%02x", stream[len + 1]);
		zassert_equal(stream[len + 2], CONFIG_MG_SBC_BITPOOL);
		len += n;
		nframes++;
	}
	dump("sbc", stream, len);

	/* Decode with the vendored decoder. */
	sbc_t dec;
	struct sbc_frame fr;
	int out = 0;

	sbc_reset(&dec);
	for (size_t off = 0; off < len; off += 60) {
		zassert_equal(sbc_probe(&stream[off], &fr), 0);
		zassert_false(fr.msbc);
		zassert_equal(fr.freq, SBC_FREQ_16K);
		zassert_equal(fr.mode, SBC_MODE_MONO);
		zassert_equal(fr.bam, SBC_BAM_LOUDNESS);
		zassert_equal(fr.nblocks, 16);
		zassert_equal(fr.nsubbands, 8);
		zassert_equal(sbc_get_frame_size(&fr), 60);
		zassert_equal(sbc_decode(&dec, &stream[off], 60, &fr, &pcm_out[out], 1, NULL, 0), 0);
		out += 128;
	}
	int lag = 0;
	double snr = best_snr(pcm_out, out, 200, &lag);

	printk("SBC: %d frames, %u bytes (%u kb/s), SNR %.1f dB at lag %d\n", nframes,
	       (unsigned)len, (unsigned)(len * 8 / SECONDS / 1000), snr, lag);
	zassert_true(snr > 20.0, "SBC SNR %.1f dB", snr);
}

ZTEST(codec, test_lc3_roundtrip)
{
	static LC3_DECODER_MEM_T(10000, 16000) dmem;
	struct mg_audio_format f;
	size_t len = 0;
	int out = 0;

	make_signal();
	zassert_equal(mg_codec_format(mg_data_type_audio_lc3, &f), 0);
	zassert_equal(mg_codec_open(mg_data_type_audio_lc3), 0);
	for (int i = 0; i + f.frame_samples <= N; i += f.frame_samples) {
		int n = mg_codec_encode(&pcm_in[i], &stream[len], sizeof(stream) - len);

		zassert_equal(n, 40);
		len += n;
	}
	dump("lc3", stream, len);

	lc3_decoder_t dec = lc3_setup_decoder(10000, 16000, 0, &dmem);

	zassert_not_null(dec);
	for (size_t off = 0; off < len; off += 40) {
		zassert_equal(lc3_decode(dec, &stream[off], 40, LC3_PCM_FORMAT_S16, &pcm_out[out], 1),
			      0, "frame at %u failed", (unsigned)off);
		out += 160;
	}
	int lag = 0;
	double snr = best_snr(pcm_out, out, 200, &lag);

	printk("LC3: %u frames, %u bytes (%u kb/s), SNR %.1f dB at lag %d\n",
	       (unsigned)(len / 40), (unsigned)len, (unsigned)(len * 8 / SECONDS / 1000), snr, lag);
	zassert_true(snr > 12.0, "LC3 SNR %.1f dB", snr);
}

/* LC3 at 16 kb/s (20 B frames), the low-bitrate clip format: decodes with
 * Google's liblc3 to the signal. */
ZTEST(codec, test_lc3_16kbps_roundtrip)
{
	static LC3_DECODER_MEM_T(10000, 16000) dmem;
	struct mg_audio_format f;
	size_t len = 0;
	int out = 0;

	make_signal();
	zassert_equal(mg_codec_format_cfg(mg_data_type_audio_lc3, 16000, 16, &f), 0);
	zassert_equal(mg_codec_open_fmt(&f), 0);
	for (int i = 0; i + f.frame_samples <= N; i += f.frame_samples) {
		int n = mg_codec_encode(&pcm_in[i], &stream[len], sizeof(stream) - len);

		zassert_equal(n, 20);
		len += n;
	}
	dump("lc3-16k", stream, len);

	lc3_decoder_t dec = lc3_setup_decoder(10000, 16000, 0, &dmem);

	zassert_not_null(dec);
	for (size_t off = 0; off < len; off += 20) {
		zassert_equal(lc3_decode(dec, &stream[off], 20, LC3_PCM_FORMAT_S16, &pcm_out[out], 1),
			      0, "frame at %u failed", (unsigned)off);
		out += 160;
	}
	int lag = 0;
	double snr = best_snr(pcm_out, out, 200, &lag);

	printk("LC3 16 kb/s: %u frames, %u bytes (%u kb/s), SNR %.1f dB at lag %d\n",
	       (unsigned)(len / 20), (unsigned)len, (unsigned)(len * 8 / SECONDS / 1000), snr, lag);
	zassert_equal(len * 8 / SECONDS / 1000, 16);
	zassert_true(snr > 6.0, "LC3 16 kb/s SNR %.1f dB", snr);
}

/* LC3 at 24 kHz: 240 samples into 40 B (32 kb/s), labeled 24000;
 * decodes with Google's liblc3 at 24 kHz to the signal. */
ZTEST(codec, test_lc3_24k_roundtrip)
{
	Z_TEST_SKIP_IFNDEF(CONFIG_MG_LC3_24K);
	static LC3_DECODER_MEM_T(10000, 24000) dmem;
	static int16_t in24[24000], out24[24000 + 480];
	struct mg_audio_format f;
	uint8_t lbl[9];
	size_t len = 0;
	int out = 0;

	for (int i = 0; i < 24000; i++) {
		float t = (float)i / 24000;

		in24[i] = (int16_t)(6000.0f * sinf(2 * 3.14159265f * 440.0f * t) +
				    3000.0f * sinf(2 * 3.14159265f * 9000.0f * t));
	}
	zassert_equal(mg_codec_format_rate(mg_data_type_audio_lc3, 24000, &f), 0);
	zassert_equal(f.frame_samples, 240);
	zassert_equal(f.frame_bytes, 40);
	zassert_equal(mg_codec_change_data_type(&f, lbl), 9);
	const uint8_t want[] = {mg_command_change_data_type, mg_data_type_audio_lc3, 0xc0, 0x5d, 1,
				40, 0, 0x10, 0x27};
	zassert_mem_equal(lbl, want, sizeof(want));
	zassert_equal(mg_codec_open_fmt(&f), 0);
	for (int i = 0; i + 240 <= 24000; i += 240) {
		zassert_equal(mg_codec_encode(&in24[i], &stream[len], sizeof(stream) - len), 40);
		len += 40;
	}
	dump("lc3-24k", stream, len);

	lc3_decoder_t dec = lc3_setup_decoder(10000, 24000, 0, &dmem);

	zassert_not_null(dec);
	for (size_t off = 0; off < len; off += 40) {
		zassert_equal(lc3_decode(dec, &stream[off], 40, LC3_PCM_FORMAT_S16, &out24[out], 1),
			      0);
		out += 240;
	}
	/* SNR at the best lag, skipping 50 ms (9 kHz needs 24 kHz to survive). */
	double best = -100;
	int best_lag = 0;

	for (int lag = 0; lag <= 300; lag++) {
		double sig = 0, err = 0;

		for (int i = 1200; i + lag < out && i < 24000; i++) {
			double d = (double)out24[i + lag] - in24[i];

			sig += (double)in24[i] * in24[i];
			err += d * d;
		}
		double snr = 10 * log10(sig / (err + 1e-9));

		if (snr > best) {
			best = snr;
			best_lag = lag;
		}
	}
	printk("LC3 24 kHz: %u frames, %u bytes, SNR %.1f dB at lag %d\n", (unsigned)(len / 40),
	       (unsigned)len, best, best_lag);
	zassert_true(best > 10.0, "LC3 24 kHz SNR %.1f dB", best);
	zassert_equal(mg_codec_format_rate(mg_data_type_audio_lc3, 32000, &f), -ENOTSUP);
}

/* A live frame that doesn't fit the link's room (one Data notification,
 * ATT_MTU - 3) is cut to the largest that does before the format goes out,
 * so the announced format is what's sent. A frame that fits is left as it
 * is. */
static int16_t fit_pcm[MG_CODEC_MAX_FRAME_SAMPLES];
static uint8_t fit_out[MG_CODEC_MAX_FRAME_BYTES + 64];

/* SBC at bitpool 124 (256 B frames) on a 247-byte MTU (244 B). */
ZTEST(codec, test_fit_room_sbc)
{
	struct mg_audio_format f, g;
	struct sbc_frame fr;
	uint8_t cdt[9];
	int n;

	zassert_ok(mg_codec_format(mg_data_type_audio_sbc, &f));
	f.sbc_bitpool = 124;
	zassert_equal(mg_codec_fit(&f, 244), 1, "cut to fit");
	zassert_true(f.frame_bytes <= 244 && f.sbc_bitpool < 124);
	g = f;
	g.sbc_bitpool++;
	zassert_equal(mg_codec_fit(&g, 1000), 0);
	zassert_true(g.frame_bytes > 244, "the largest bitpool that fits");
	zassert_ok(mg_codec_open_fmt(&f));
	n = mg_codec_encode(fit_pcm, fit_out, sizeof(fit_out));
	zassert_equal(n, f.frame_bytes, "sent as announced");
	zassert_equal(sbc_probe(fit_out, &fr), 0);
	zassert_equal(fr.bitpool, f.sbc_bitpool);
	zassert_equal(sbc_get_frame_size(&fr), (unsigned int)n);
	zassert_equal(mg_codec_change_data_type(&f, cdt), 9);
	zassert_equal(cdt[5] | cdt[6] << 8, n);
	/* The configured bitpool, which fits: as it is. */
	zassert_ok(mg_codec_format(mg_data_type_audio_sbc, &f));
	g = f;
	zassert_equal(mg_codec_fit(&f, 244), 0);
	zassert_mem_equal(&f, &g, sizeof(f));
}

/* LC3 at 96 kb/s (120 B frames) on a 100-byte MTU (97 B). */
ZTEST(codec, test_fit_room_lc3)
{
	struct mg_audio_format f;
	uint8_t cdt[9];
	int n;

	zassert_ok(mg_codec_format_cfg(mg_data_type_audio_lc3, 16000, 32, &f));
	f.frame_bytes = 96 * 10000 / 8000; /* 96 kb/s */
	zassert_equal(mg_codec_fit(&f, 100 - 3), 1, "cut to fit");
	zassert_equal(f.frame_bytes, 97);
	zassert_ok(mg_codec_open_fmt(&f));
	n = mg_codec_encode(fit_pcm, fit_out, sizeof(fit_out));
	zassert_equal(n, 97, "sent as announced");
	zassert_equal(mg_codec_change_data_type(&f, cdt), 9);
	zassert_equal(cdt[5] | cdt[6] << 8, n);
	/* 32 kb/s (40 B), which fits: as it is. */
	zassert_ok(mg_codec_format_cfg(mg_data_type_audio_lc3, 16000, 32, &f));
	zassert_equal(mg_codec_fit(&f, 97), 0);
	zassert_equal(f.frame_bytes, 40);
}

ZTEST(codec, test_bad_codec)
{
	uint8_t out[64];
	int16_t pcm[160] = {0};

	zassert_equal(mg_codec_open(mg_data_type_audio_opus), -ENOTSUP);
	zassert_equal(mg_codec_open(mg_data_type_audio_sbc), 0);
	zassert_equal(mg_codec_encode(pcm, out, 10), -ENOMEM, "no room for a frame");
}

ZTEST_SUITE(codec, NULL, NULL, NULL, NULL, NULL);
```

## src/test_flash_writes.c
```c
/*
 * Copyright (c) Meta Platforms, Inc. and affiliates.
 *
 * Licensed under the Apache License, Version 2.0 (the "License");
 * you may not use this file except in compliance with the License.
 * You may obtain a copy of the License at
 *
 *     http://www.apache.org/licenses/LICENSE-2.0
 *
 * Unless required by applicable law or agreed to in writing, software
 * distributed under the License is distributed on an "AS IS" BASIS,
 * WITHOUT WARRANTIES OR CONDITIONS OF ANY KIND, either express or implied.
 * See the License for the specific language governing permissions and
 * limitations under the License.
 */

/* No flash write per event a peer starts: connecting, subscribing, the
 * client's per-connection settings, request_status and a link drop, fifty
 * times over, write nothing; and a stranger's stored settings reach flash at
 * most once per 10 min. */

#include <zephyr/kernel.h>
#include <zephyr/settings/settings.h>
#include <zephyr/ztest.h>

#include "fakes.h"
#include "mg_settings.h"
#include "mg_setup_store.h"
#include "mg_core.h"
#include "mg_session.h"
#include "mgcommands.h"

static atomic_t writes;

int __real_settings_save_one(const char *name, const void *value, size_t val_len);
int __wrap_settings_save_one(const char *name, const void *value, size_t val_len)
{
	atomic_inc(&writes);
	return __real_settings_save_one(name, value, val_len);
}

int __real_settings_delete(const char *name);
int __wrap_settings_delete(const char *name)
{
	atomic_inc(&writes);
	return __real_settings_delete(name);
}

static void rx(const uint8_t *m, size_t n)
{
	mg_session_rx(MG_ATT_CONTROL, m, n);
}

ZTEST(flash_writes, test_no_write_per_connection)
{
	static const uint8_t status[] = {mg_command_request_status};
	static const uint8_t ptt[] = {mg_command_set_settings,
				      mg_setting_parameter_push_to_talk_enabled, 1};
	/* client_app: the app's name, then its version (empty here). */
	static const uint8_t app[] = {mg_command_set_settings, mg_setting_parameter_client_app,
				      5, 'M', 'u', 's', 'e', ' ', 0};

	mg_session_disconnected();
	atomic_set(&writes, 0);
	for (int i = 0; i < 50; i++) {
		mg_session_connected();
		mg_session_subscribed(MG_ATT_CONTROL, true);
		mg_session_subscribed(MG_ATT_DATA, true);
		rx(status, sizeof(status));
		fake_reset();
		rx(ptt, sizeof(ptt));
		rx(app, sizeof(app));
		/* Both taken (a malformed app would be refused before it reached
		 * the per-connection path). */
		zassert_is_null(fake_find(MG_ATT_CONTROL, mg_command_error, 0), "a setting refused");
		zassert_equal(mg_settings_get()->push_to_talk_enabled, 1);
		mg_session_disconnected();
	}
	zassert_equal(atomic_get(&writes), 0, "%ld flash writes across 50 links",
		      (long)atomic_get(&writes));
	fake_connect();
}

static void *setup(void)
{
	fake_init_once();
	return NULL;
}

/* Not set up: a stranger's setting writes reach flash at most once per
 * 10 min; the change that waits goes at the end of the window. */
ZTEST(flash_writes, test_stranger_settings_coalesced)
{
	static const uint8_t lc3[] = {mg_command_set_settings, mg_setting_parameter_audio_codec,
				      mg_data_type_audio_lc3};
	static const uint8_t sbc[] = {mg_command_set_settings, mg_setting_parameter_audio_codec,
				      mg_data_type_audio_sbc};

	Z_TEST_SKIP_IFNDEF(CONFIG_MG_LC3);
	if (mg_setup_store_complete()) {
		zassert_equal(mg_setup_store_erase(), 0);
	}
	mg_settings_flush();
	k_sleep(K_MINUTES(11)); /* past any earlier save's window */
	atomic_set(&writes, 0);
	for (int i = 0; i < 40; i++) {
		rx(i & 1 ? sbc : lc3, sizeof(lc3));
		k_sleep(K_SECONDS(10));
	}
	zassert_equal(atomic_get(&writes), 1, "%ld writes for 40 changes in ~7 min",
		      (long)atomic_get(&writes));
	k_sleep(K_MINUTES(4));
	zassert_equal(atomic_get(&writes), 2, "the waiting change at the window's end");
	rx(lc3, sizeof(lc3));
	mg_settings_flush(); /* a planned power off */
	zassert_equal(atomic_get(&writes), 3, "the waiting change goes at the flush");
	rx(sbc, sizeof(sbc));
	mg_settings_flush();
}

ZTEST_SUITE(flash_writes, NULL, setup, NULL, NULL, NULL);
```

## src/test_hpf.c
```c
/*
 * Copyright (c) Meta Platforms, Inc. and affiliates.
 *
 * Licensed under the Apache License, Version 2.0 (the "License");
 * you may not use this file except in compliance with the License.
 * You may obtain a copy of the License at
 *
 *     http://www.apache.org/licenses/LICENSE-2.0
 *
 * Unless required by applicable law or agreed to in writing, software
 * distributed under the License is distributed on an "AS IS" BASIS,
 * WITHOUT WARRANTIES OR CONDITIONS OF ANY KIND, either express or implied.
 * See the License for the specific language governing permissions and
 * limitations under the License.
 */



#include <zephyr/ztest.h>

#include "mg_hpf.h"

#define RATE 16000

/* Primed at the start of a capture: a mic sitting at -1100 starts at zero,
 * with no settling transient in the first frames. */
ZTEST(hpf, test_primed_start)
{
	static int16_t x[480];
	struct mg_hpf f;

	mg_hpf_init(&f, 30, RATE);
	for (size_t i = 0; i < ARRAY_SIZE(x); i++) {
		x[i] = -1100;
	}
	mg_hpf_run(&f, x, ARRAY_SIZE(x));
	for (size_t i = 0; i < ARRAY_SIZE(x); i++) {
		zassert_equal(x[i], 0, "sample %u is %d", (unsigned int)i, x[i]);
	}
	/* And again after a reset (the next capture), from a new level. */
	mg_hpf_reset(&f);
	for (size_t i = 0; i < ARRAY_SIZE(x); i++) {
		x[i] = 500;
	}
	mg_hpf_run(&f, x, 160);
	zassert_equal(x[0], 0);
	zassert_equal(x[159], 0);
}

ZTEST_SUITE(hpf, NULL, NULL, NULL, NULL, NULL);
```

## src/test_throughput.c
```c
/*
 * Copyright (c) Meta Platforms, Inc. and affiliates.
 *
 * Licensed under the Apache License, Version 2.0 (the "License");
 * you may not use this file except in compliance with the License.
 * You may obtain a copy of the License at
 *
 *     http://www.apache.org/licenses/LICENSE-2.0
 *
 * Unless required by applicable law or agreed to in writing, software
 * distributed under the License is distributed on an "AS IS" BASIS,
 * WITHOUT WARRANTIES OR CONDITIONS OF ANY KIND, either express or implied.
 * See the License for the specific language governing permissions and
 * limitations under the License.
 */


#include <string.h>

#include <zephyr/sys/byteorder.h>
#include <zephyr/ztest.h>

#include "fakes.h"
#include "mg_session.h"
#include "mg_throughput.h"
#include "mgcommands.h"

/* Through mg_session. */

#define RX(...)                                                                                    \
	do {                                                                                       \
		const uint8_t _b[] = {__VA_ARGS__};                                                \
		mg_session_rx(MG_ATT_CONTROL, _b, sizeof(_b));                                     \
	} while (0)

static void *setup(void)
{
	fake_init_once();
	return NULL;
}

static void before(void *f)
{
	ARG_UNUSED(f);
	fake_connect();
	fake_reset();
	fake_audio_state = MG_AUDIO_IDLE;
}

static void after(void *f)
{
	ARG_UNUSED(f);
	fake_notify_delay_us = 0;
	mg_session_disconnected();
}

static const struct fake_note *report_note(void)
{
	for (int i = fake_nnotes - 1; i >= 0; i--) {
		const struct fake_note *n = &fake_notes[i];

		if (n->ch == MG_ATT_CONTROL && n->len == 19 && n->data[0] == mg_command_device_action) {
			return n;
		}
	}
	return NULL;
}

ZTEST(throughput, test_packet_format_and_counting)
{
	uint8_t p[244];
	struct mg_tp_count c = {0};
	uint8_t r[19];

	mg_tp_fill(p, sizeof(p), 0x01020304);
	zassert_equal(sys_get_le32(p), 0x01020304);
	zassert_equal(p[4], (uint8_t)(0x04 + 4));
	zassert_equal(p[243], (uint8_t)(0x04 + 243));

	/* Packets 0, 1, 2, then 5 (two missing), then a late 3: two gaps. */
	for (uint32_t s = 0; s < 3; s++) {
		mg_tp_fill(p, sizeof(p), s);
		zassert_true(mg_tp_account(&c, p, sizeof(p), 1000 + s * 5));
	}
	mg_tp_fill(p, sizeof(p), 5);
	zassert_true(mg_tp_account(&c, p, sizeof(p), 1020));
	mg_tp_fill(p, sizeof(p), 3);
	zassert_true(mg_tp_account(&c, p, sizeof(p), 1025));
	zassert_false(mg_tp_account(&c, p, 3, 1030), "too short for a sequence");
	zassert_equal(c.packets, 5);
	zassert_equal(c.bytes, 5 * 244);
	zassert_equal(c.gaps, 2);
	zassert_equal(mg_tp_report(&c, r), 19);
	zassert_equal(r[0], mg_command_device_action);
	zassert_equal(r[1], mg_device_action_throughput_test);
	zassert_equal(r[2], mg_throughput_test_stop);
	zassert_equal(sys_get_le32(&r[3]), 5 * 244);
	zassert_equal(sys_get_le32(&r[7]), 5);
	zassert_equal(sys_get_le32(&r[11]), 25, "first to last packet");
	zassert_equal(sys_get_le32(&r[15]), 2);
}

ZTEST(throughput, test_refused)
{
	/* Busy while audio is live. */
	fake_audio_state = MG_AUDIO_LIVE;
	RX(mg_command_device_action, mg_device_action_throughput_test, mg_throughput_test_send, 0,
	   0);
	zassert_equal(fake_notes[0].data[0], mg_command_error);
	zassert_equal(sys_get_le16(&fake_notes[0].data[3]), mg_error_code_busy);
	zassert_false(mg_tp_running());
	fake_audio_state = MG_AUDIO_IDLE;
	/* Unknown direction, unknown action, nothing at all. */
	fake_reset();
	RX(mg_command_device_action, mg_device_action_throughput_test, 7);
	zassert_equal(sys_get_le16(&fake_notes[0].data[3]), mg_error_code_invalid_value);
	fake_reset();
	RX(mg_command_device_action, 0);
	zassert_equal(sys_get_le16(&fake_notes[0].data[3]), mg_error_code_unsupported);
	fake_reset();
	RX(mg_command_device_action);
	zassert_equal(sys_get_le16(&fake_notes[0].data[3]), mg_error_code_invalid_length);
	/* A stop with nothing run reports zeros. */
	fake_reset();
	RX(mg_command_device_action, mg_device_action_throughput_test, mg_throughput_test_stop);
	zassert_not_null(report_note());
	/* A disconnect ends a receive test silently. */
	RX(mg_command_device_action, mg_device_action_throughput_test, mg_throughput_test_receive,
	   0, 0);
	mg_session_disconnected();
	zassert_false(mg_tp_running());
	fake_connect();
}

ZTEST_SUITE(throughput, NULL, setup, before, after, NULL);
```
